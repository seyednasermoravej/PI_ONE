## .vscode/dts/bindings/busy-tft.yaml
```yaml
description: GPIO pin to check whether the TFT LCD is busy or not. 

compatible: "busy-tft"

properties:
  gpios:
    type: phandle-array
    required: true
    description: |
      The GPIO connected to the TFT LCD.
```
